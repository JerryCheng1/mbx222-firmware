## defconfig
```kconfig
# MBX222 Board Configuration
# Alder Lake N + ITE IT5771E EC (eSPI) + DDR4 SODIMM
# Based on Nissa baseboard with Craask variant reference

# Board selection
CONFIG_BOARD_GOOGLE_MBX222=y
CONFIG_BOARD_GOOGLE_BASEBOARD_BRYA=y

# SoC configuration
CONFIG_SOC_INTEL_ALDERLAKE=y
CONFIG_SOC_INTEL_ALDERLAKE_NISSA=y

# CPU / FSP
CONFIG_CPU_SPECIFIC_OPTIONS=y
CONFIG_FSP_USE_REPO=y
CONFIG_INTEL_CARDBUS_PLATFORM=y

# VBT (Video BIOS Table) - ADL-N specific
CONFIG_HAVE_VBT=y
CONFIG_VBT_FILE="3rdparty/fsp/AlderLakeN/Vbt/Vbt_ADLN.bin"

# DDR4 SODIMM memory (not LP5X)
CONFIG_MEMORY_SODIMM=y
CONFIG_HAVE_DDR4_SUPPORT=y

# eSPI interface (for ITE IT5771E EC)
CONFIG_EC_GOOGLE_CHROMEEC=y
CONFIG_EC_GOOGLE_CHROMEEC_ESPI=y
CONFIG_SUPERIO_ITE_IT5771E=y
CONFIG_SUPERIO_ITE_IT5771E_COM1=y

# Console / Debug
CONFIG_CONSOLE_SERIAL=y
CONFIG_DRIVERS_UART_8250IO=y
CONFIG_UART_FOR_CONSOLE=0
CONFIG_TTYS0_BASE=0x3f8
CONFIG_TTYS0_BAUD=115200
CONFIG_CONSOLE_CBMEM=y
CONFIG_DEFAULT_CONSOLE_LOGLEVEL_8=y
CONFIG_DEFAULT_CONSOLE_LOGLEVEL=8

# ChromeOS
CONFIG_CHROMEOS=y
CONFIG_CHROMEOS_VBOOT=y
CONFIG_VBOOT=y

# TPM
CONFIG_TPM_GOOGLE_TI50=y
CONFIG_MAINBOARD_HAS_TPM_CR50=y

# Payload - TianoCore (UEFI payload)
CONFIG_PAYLOAD_TIANOCORE=y

# Display
CONFIG_LINEAR_FRAMEBUFFER=y
CONFIG_BOOTSPLASH=y

# Network / WiFi
CONFIG_DRIVERS_WIFI_GENERIC=y
CONFIG_DRIVERS_INTEL_CNVI=y
CONFIG_USE_SAR=y

# Storage
CONFIG_DRIVERS_STORAGE_NVME=y
CONFIG_DRIVERS_STORAGE_SATA=y

# USB
CONFIG_DRIVERS_USB_XHCI=y
CONFIG_DRIVERS_USB_ACPI=y

# Audio
CONFIG_DRIVERS_INTEL_SOUNDWIRE=y
CONFIG_DRIVERS_I2C_MAX98373=y
CONFIG_DRIVERS_I2C_RT1019=y

# I2C
CONFIG_DRIVERS_I2C_GENERIC=y
CONFIG_DRIVERS_I2C_DESIGNWARE=y

# Thermal
CONFIG_DRIVERS_INTEL_DPTC_SUPPORT=y

# Bootblock / stages
CONFIG_HAVE_BOOTBLOCK=y
CONFIG_HAVE_VERSTAGE=y
CONFIG_HAVE_ROMSTAGE=y
CONFIG_HAVE_RAMSTAGE=y

# Build optimization
CONFIG_COMPRESS_RAMSTAGE_LZMA=y
CONFIG_HAVE_SMI_HANDLER=y
CONFIG_SMM_TSEG=y
CONFIG_SMM_MODULES=y

# ACPI
CONFIG_HAVE_ACPI_TABLES=y
CONFIG_HAVE_ACPI_RESUME=y
CONFIG_ACPI_BERT=y

# SPD
CONFIG_DIMM_SPD=y

# SerialIO
CONFIG_SOC_INTEL_COMMON_BLOCK_SERIALIO=y

# PCH
CONFIG_PCH_SPECIFIC_OPTIONS=y

# PCIe
CONFIG_PCIEXP_ASPM=y
CONFIG_PCIEXP_CLK_PM=y
CONFIG_PCIEXP_L1_SUB_STATE=y

# Firmware configuration
CONFIG_FW_CONFIG=y
```

## patches/Kconfig.name.patch
```kconfig
diff --git a/src/mainboard/google/brya/Kconfig.name b/src/mainboard/google/brya/Kconfig.name
index ORIGINAL..mbx222 100644
--- a/src/mainboard/google/brya/Kconfig.name
+++ b/src/mainboard/google/brya/Kconfig.name
@@ -56,6 +56,9 @@
 config BOARD_GOOGLE_BANSHEE
 	bool "Banshee"
 
+config BOARD_GOOGLE_MBX222
+	bool "MBX222"
+
 config BOARD_GOOGLE_NIVVIKS
 	bool "Nivviks"
```

## patches/Kconfig.patch
```kconfig
diff --git a/src/mainboard/google/brya/Kconfig b/src/mainboard/google/brya/Kconfig
index ORIGINAL..mbx222 100644
--- a/src/mainboard/google/brya/Kconfig
+++ b/src/mainboard/google/brya/Kconfig
@@ -400,6 +400,26 @@
 
 endif # BOARD_GOOGLE_BANSHEE
 
+config BOARD_GOOGLE_MBX222
+	bool "->  MBX222 (Alder Lake N, ITE IT5771E EC)"
+	select BOARD_GOOGLE_BASEBOARD_BRYA
+	select CHROMEOS
+	select DRIVERS_INTEL_DPTC_SUPPORT
+	select DRIVERS_I2C_GENERIC
+	select DRIVERS_USB_ACPI
+	select EC_GOOGLE_CHROMEEC
+	select EC_GOOGLE_CHROMEEC_ESPI
+	select HAVE_WWAN_POWER_SEQUENCE
+	select MAINBOARD_HAS_CHROMEOS_DYNAMIC
+	select MEMORY_SODIMM
+	select SOC_INTEL_ALDERLAKE
+	select SOC_INTEL_COMMON_BLOCK_HDA
+	select SUPERIO_ITE_IT5771E
+	select SYSTEM_TYPE_LAPTOP
+	select TPM_GOOGLE_TI50
+	select USE_SAR
+	select VBOOT
+	help
+	  MBX222 board based on Alder Lake N with ITE IT5771E EC via eSPI,
+	  DDR4 SODIMM, 1x NVMe, 1x SATA, onboard CNVi WLAN.
+
 config BOARD_GOOGLE_NIVVIKS
 	bool "->  Nivviks"
 	select BOARD_GOOGLE_BASEBOARD_BRYA
```
